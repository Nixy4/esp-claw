## application/edge_agent/boards/lilygo/lilygo_t_display_p4/v1/Kconfig.projbuild
```kconfig
menu "lilygo t-display-p4 configuration"

    choice
        prompt "Select the camera type"
        default CAMERA_TYPE_OV2710
            config CAMERA_TYPE_SC2336
                bool "SC2336"
            config CAMERA_TYPE_OV2710
                bool "OV2710"
            config CAMERA_TYPE_OV5645
                bool "OV5645"
    endchoice

    choice
        prompt "Select the color format of the screen"
        default SCREEN_PIXEL_FORMAT_RGB565
            config SCREEN_PIXEL_FORMAT_RGB565
                bool "RGB565"
            config SCREEN_PIXEL_FORMAT_RGB888
                bool "RGB888"
    endchoice

    choice
        prompt "Select the color format of the camera"
        default CAMERA_PIXEL_FORMAT_RGB565
            config CAMERA_PIXEL_FORMAT_RGB565
                bool "RGB565"
            config CAMERA_PIXEL_FORMAT_RGB888
                bool "RGB888"
    endchoice

endmenu
```
